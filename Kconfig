## Kconfig
```kconfig
# Configuration for using with kconfig-frontends

config PASCAL
	bool "Enable Pascal Support"
	default n
	---help---
		Enable building of Pascal support

if PASCAL

config PASCAL_DEBUG
	bool "Enable Debug Features"
	default n
	---help---
		Enable DEBUG features in tools and run-time code.

config PASCAL_TRACE
	bool "Enable Function Tracing"
	default n
	---help---
		Enable DEBUG output on entry into each function.

endif
```

## insn16/Kconfig.insn
```kconfig
menu "INSN16 Options"

config PASCAL_HEAPDEBUG
	bool "Heap debug"
	default n
	---help---
		Enable verbose run-time dumping of all chunks in the heap after
		each allocation and free.  This debug output is useful for
		debugging suspected memory manage bugs.

config PASCAL_MEMINFO
	bool "Memory usage debug"
	default n
	---help---
		Enable terse memory usage output on each allocation and free.
		This debug output is useful for debugging memory leaks.

endmenu # Pascal Applications
```

## papps/Kconfig.papps
```kconfig
menu "Pascal Applications"

config PASCAL_EXECDIR
	string "Path to Pascal executables"
	default "papps/image/"
	---help---
		Path to the directory contain the Pascal executable file (.pex) that
		are available to the shell.  This path is assumed to contain the final
		delimiter (probably '/') after which file names may be appended.

config PASCAL_HAVEHOME
	bool "CD to a home directory"
	default y
	---help---
		Pascal applications like the Pascal shell or PStart will change to
		this home directory when they startup up.  This permits you to
		configure fixed, relative paths to resources needed by the Pascal
		applications.  For example, the path to the directory where Pascal
		executables are retained.

config PASCAL_HOMEDIR
	string "Home directory path"
	default $PASTOPDIR
	---help---
		This is Pascal application home directory.  Pascal applications like
		Pascal shell or PStart will change to this home directory when they
		startup up.  This permits you to configure fixed, relative paths to
		resources needed by the Pascal applications.  For example, the path
		to the directory where Pascal executables are retained.

source "$PASTOPDIR/papps/pstart/Kconfig.pstart"
source "$PASTOPDIR/papps/phello/Kconfig.phello"
source "$PASTOPDIR/papps/pshell/Kconfig.pshell"

endmenu # Pascal Applications
```

## papps/phello/Kconfig.phello
```kconfig
config PASCAL_HELLO
	bool "Hello, World! Pascal Example"
	default n
	depends on PASCAL_BUILD_PAPPS
	---help---
		Enable building of the the Pascal "Hello, World!" sample application.
```

## papps/pshell/Kconfig.pshell
```kconfig
config PASCAL_PSHELL
	bool "Pascal Shell"
	default n
	depends on PASCAL_BUILD_PAPPS
	---help---
		Enable building of Pascal shell.

if PASCAL_PSHELL

endif # PASCAL_PSHELL
```

## papps/pstart/Kconfig.pstart
```kconfig
config PASCAL_STARTUP
	bool "Enable Pascal Start-Up Application"
	default n
	depends on PASCAL_BUILD_NUTTX
	---help---
		Enable building of the Pascal initialization task for NuttX.

if PASCAL_STARTUP

choice
	prompt "Pascal Start-Up Media"

config PASCAL_STARTUP_FILE
	bool "Pascal start-up resides in a file"

#config PASCAL_STARTUP_INMEMORY
#	bool "Pascal start-up resides in memory"

endchoice # Pascal Start-Up Media

#config PASCAL_STARTUP_FILENAME
#	string "Pascal start-up file name"
#	default "Pshell.pex"
#	depends on PASCAL_STARTUP_FILE

config PASCAL_STARTUP_FILENAME
	string
	default "Pshell.pex"
	---help---
		This is the Pascal executable file name.  The full path to the
		executable will be formed by pre-pending CONFIG_PASCAL_EXECDIR.

#config PASCAL_STARTUP_INMEMORY
#	string "Pascal start-up in-memory symbol name"
#	default "g_pStartUpPex"
#	depends on PASCAL_STARTUP_INMEMORY

config PASCAL_STARTUP_STKSIZE
	int "Pascal start-up stack size"
	default 4096
	---help---
		Stack memory set aside for code execution.

config PASCAL_STARTUP_STRSIZE
	int "Pascal start-up string stack size (total)"
	default 1024
	---help---
		Total stack memory set aside for strings.

config PASCAL_STARTUP_HEAPSIZE
	int "Pascal start-up heap size"
	default 256
	---help---
		Memory set aside for usage with new and dispose.

config PASCAL_AUTOMOUNT
	bool "Mount filesystem"
	default n
	---help---
		Mount file system containing Pascal executables at startup.
		Mount point is the same as CONFIG_PASCAL_EXECDIR.

if PASCAL_AUTOMOUNT

config PASCAL_MOUNTDEV
	string "Mount device"
	default "/dev/mmcsd0"
	---help---
		The block or MTD device to mount at CONFIG_PASCAL_EXECDIR.  Likely
		settings include "dev/mmcsd0" for an SD card or /dev/ram0 for
		an in-memory file system.

config PASCAL_FSTYPE
	string "File system type"
	default "vfat"
	---help---
		The type of filesystem to be mounted.  Likely settings are "vfat"
		for an SD card or "romfs" for an in-mememory file system.

config PASCAL_MOUNT_OPTIONS
	string "Mount options"
	default ""
	---help---
		Mount option data (final parameter of mount() call). Necessary for
		certin file system types such as HostFS.

endif

config PASCAL_STARTUP_DEBUG
	bool "Enable P-Code debugger at startup"
	default n
	depends on PASCAL_DEBUGGER
	---help---
		The start-up Pascal program with begin in the Pascal P-code debugger.

endif # PASCAL_STARTUP
```

## tools/Kconfig.body
```kconfig
menu "Pascal Target Tools"
	depends on PASCAL_BUILD_NUTTX

config PASCAL_TARGET_TOOLS
	bool "Build tools for target"
	default n
	depends on PASCAL_BUILD_NUTTX
	---help---
		Build Pascal tools (compiler, optimizer, linker, lister) for the
		target platform.  Default:  Only the run-time components will be
		built for the target.

config PASCAL_PRIORITY
	int "Compiler task priority"
	depends on PASCAL_TARGET_TOOLS
	default 100

config PASCAL_STACKSIZE
	int "Compiler stack size"
	default 2048
	depends on PASCAL_TARGET_TOOLS

config PASCAL_POPT_PRIORITY
	int "Optimizer task priority"
	depends on PASCAL_TARGET_TOOLS
	default 100

config PASCAL_POPT_STACKSIZE
	int "Optimizer stack size"
	default 2048
	depends on PASCAL_TARGET_TOOLS

config PASCAL_PLINK_PRIORITY
	int "Linker task priority"
	depends on PASCAL_TARGET_TOOLS
	default 100

config PASCAL_PLINK_STACKSIZE
	int "Linker stack size"
	default 2048
	depends on PASCAL_TARGET_TOOLS

config PASCAL_PLIST_PRIORITY
	int "Lister task priority"
	depends on PASCAL_TARGET_TOOLS
	default 100

config PASCAL_PLIST_STACKSIZE
	int "Lister stack size"
	default 2048
	depends on PASCAL_TARGET_TOOLS

config PASCAL_PRUN_PRIORITY
	int "Run-time task priority"
	default 100
	depends on PASCAL_BUILD_NUTTX

config PASCAL_PRUN_STACKSIZE
	int "Run-time stack size"
	default 2048
	depends on PASCAL_BUILD_NUTTX

endmenu # Target tool options

menu "Pascal Applications"

config PASCAL_STARTUP
	bool "Enable Pascal Start-Up Application"
	default n
	depends on PASCAL_BUILD_NUTTX
	---help---
		Enable building of the the Pascal Pascal initialization task for NuttX.

if PASCAL_STARTUP

choice
	prompt "Pascal Start-Up Media"

config PASCAL_STARTUP_FILE
	bool "Pascal start-up resides in a file"

#config PASCAL_STARTUP_INMEMORY
#	bool "Pascal start-up resides in memory"

endchoice # Pascal Start-Up Media

#config PASCAL_STARTUP_FILENAME
#	string "Pascal start-up file name"
#	default "pstartup.pex"
#	depends on PASCAL_STARTUP_FILE

config PASCAL_STARTUP_FILENAME
	string
	default "pstartup.pex"

#config PASCAL_STARTUP_INMEMORY
#	string "Pascal start-up in-memory symbol name"
#	default "g_pStartUpPex"
#	depends on PASCAL_STARTUP_INMEMORY

config PASCAL_STARTUP_DEBUG
	bool "Enable P-Code debugger at startup"
	default n
	---help---
		The start-up Pascal program with begin in the Pascal P-code debugger.

config PASCAL_STARTUP_STKSIZE
	int "Pascal start-up stack size"
	default 4096
	---help---
		Stack memory set aside for code execution.

config PASCAL_STARTUP_STRSIZE
	int "Pascal start-up string stack size (total)"
	default 1024
	---help---
		Total stack memory set aside for strings.

config PASCAL_STARTUP_STRALLOC
	int "Pascal start-up string stack alloc"
	default 128
	---help---
		String memory allocation per standard string instantiation.

config PASCAL_STARTUP_HEAPSIZE
	int "Pascal start-up heap size"
	default 256
	---help---
		Memory set aside for usage with new and dispose.

endif # PASCAL_STARTUP
endmenu # Pascal Applications

config PASCAL_DEBUG
	bool "Enable Debug Features"
	default n
	---help---
		Enable DEBUG features in tools and run-time code.

config PASCAL_TRACE
	bool "Enable Function Tracing"
	default n
	---help---
		Enable DEBUG output on entry into each function.
```

## tools/Kconfig.main
```kconfig
menu "Target Machine Description"

config PASCAL_POINTERSIZE
	int "Size of a pointer"
	default 4
	---help---
		Size of a pointer on the target machine.  Typically one of 2 bytes
		(16-bits), 4 bytes (32-bits), or 8 bytes(64-bytes).  This setting is
		used to dyamically size some Pascal types that are containers of the
		target pointer values (vs. the VM's pointer size which is always 2).

endmenu

menu "Pascal Target Tools"
	depends on PASCAL_BUILD_NUTTX

config PASCAL_TARGET_TOOLS
	bool "Build tools for target"
	default n
	depends on PASCAL_BUILD_NUTTX
	---help---
		Build Pascal tools (compiler, optimizer, linker, lister) for the
		target platform.  Default:  Only the run-time components will be
		built for the target.

config PASCAL_PRIORITY
	int "Compiler task priority"
	depends on PASCAL_TARGET_TOOLS
	default 100

config PASCAL_STACKSIZE
	int "Compiler stack size"
	default 2048
	depends on PASCAL_TARGET_TOOLS

config PASCAL_POPT_PRIORITY
	int "Optimizer task priority"
	depends on PASCAL_TARGET_TOOLS
	default 100

config PASCAL_POPT_STACKSIZE
	int "Optimizer stack size"
	default 2048
	depends on PASCAL_TARGET_TOOLS

config PASCAL_PLINK_PRIORITY
	int "Linker task priority"
	depends on PASCAL_TARGET_TOOLS
	default 100

config PASCAL_PLINK_STACKSIZE
	int "Linker stack size"
	default 2048
	depends on PASCAL_TARGET_TOOLS

config PASCAL_PLIST_PRIORITY
	int "Lister task priority"
	depends on PASCAL_TARGET_TOOLS
	default 100

config PASCAL_PLIST_STACKSIZE
	int "Lister stack size"
	default 2048
	depends on PASCAL_TARGET_TOOLS

config PASCAL_PRUN_PRIORITY
	int "Run-time task priority"
	default 100
	depends on PASCAL_BUILD_NUTTX

config PASCAL_PRUN_STACKSIZE
	int "Run-time stack size"
	default 2048
	depends on PASCAL_BUILD_NUTTX

endmenu # Target tool options

config PASCAL_BUILD_PAPPS
	bool
	default PASCAL_TARGET_TOOLS || !PASCAL_BUILD_NUTTX

config PASCAL_DEFAULT_STRALLOC
	int "Default string size"
	default 80
	range 1 4095
	---help---
		When a string variable is declared without a size, then this is the
		default size of the string buffer allocation.  The default of 80 is
		typical.

config PASCAL_DEBUG
	bool "Enable debug features"
	default n
	---help---
		Enable DEBUG features in tools and run-time code.

config PASCAL_DEBUGGER
	bool "Enable debug monitor"
	default n
	---help---
		Enable building a Pascal run-time debug monitor into the run-time
		code.  With this option, the prun program will accept an argument,
		--debug, to enter the Pascal debug monitory
```
